#include <Ticker.h>
#include <PxMatrix.h>

Ticker display_ticker;

// Pins for LED MATRIX // works for ESP32 devkit
#define P_LAT 2
#define P_A 17
#define P_B 16
#define P_C 4
//#define P_D 5 // 5
#define P_OE 15

#define LEDG1 36
#define LEDG2 39
#define LEDG3 34
#define LEDG4 1
#define LEDG5 3

#define LEDR1 33
#define LEDY1 12

#define Buzzer 32

PxMATRIX display(32, 32, P_LAT, P_OE,P_A,P_B,P_C); // changed from default

uint16_t static image[] = {
0x9c0c,0x6413,0x9800,0x6000,0xf946,0xf800,0xfc06,0xfc06,0xffe0,0xffe0,0x0546,0x354c,0x0559,0x055f,0x3159,0x32b9,   // (16) pixels
0x9ab3,0x9ab3,0xffff,0xffff,0xffff,0xffff,0xffff,0xffff,0xffff,0xffff,0xffff,0xffff,0xffff,0xffff,0xffff,0xffff,   // (32) pixels
0x6413,0x9c0c,0x9806,0x9800,0xc806,0xf946,0xfc06,0xfc00,0xffe0,0xffe0,0x354c,0x0546,0x055f,0x0559,0x32b9,0x6159,   // (48) pixels
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0xcab3,0x9ab3,0xffff,0xffff,0xffff,0xffff,0xffff,0xffff,0xffff,0xffff,0xffff,0xffff,0xffff,0xffff,0xffff,0xffff   // (1024) pixels
};



// ISR for display refresh
void display_updater()
{
  display.display(10);
}

void setup() {
  Serial.begin(115200);
  for (int i = 0; i < 1024; i++) {Serial.println(image[i], HEX);}
  display.begin(8, 14, 13, 5, 23); //(row_pattern, CLK, MOSI, MISO, SS)
  display.clearDisplay();
  display_ticker.attach(0.002, display_updater);
  yield();
  display.clearDisplay();
  drawImage(0, 0);
  delay(500);

  pinMode(LEDG1, OUTPUT);
  pinMode(LEDG2, OUTPUT);
  pinMode(LEDG3, OUTPUT);
  pinMode(LEDG4, OUTPUT);
  pinMode(LEDG5, OUTPUT);

  pinMode(LEDR1, OUTPUT);
  pinMode(LEDY1, OUTPUT);

  pinMode(Buzzer, OUTPUT);

}

void drawImage(int x, int y)
{
  int imageHeight = 32;
  int imageWidth = 32;
  int counter = 0;
  for (int yy = 0; yy < imageHeight; yy++)
  {
    for (int xx = 0; xx < imageWidth; xx++)
    {
      display.drawPixel(xx + x , yy + y, image[counter]);
      counter++;
    }
  }
}

void drawFrame(uint16_t *frame) {
  display.clearDisplay();
  int imageHeight = 32;
  int imageWidth = 64;
  int counter = 0;
  for (int yy = 0; yy < imageHeight; yy++) {
    for (int xx = 0; xx < imageWidth; xx++) {
      display.drawPixel(xx, yy, frame[counter]);
      counter++;
    }
  }
  delay(100);
}

void loop() {
  digitalWrite(LEDG1, HIGH);
  delay(500);
  digitalWrite(LEDG2, HIGH);
  delay(500);
  digitalWrite(LEDG3, HIGH);
  delay(500);
  digitalWrite(LEDG4, HIGH);
  delay(500);
  digitalWrite(LEDG5, HIGH);
  delay(500);
  digitalWrite(LEDR1, HIGH);
  delay(500);
  digitalWrite(LEDY1, HIGH);
  delay(500);
  //digitalWrite(Buzzer, HIGH);
  //delay(500);
  digitalWrite(LEDG1, LOW);
  digitalWrite(LEDG2, LOW);
  digitalWrite(LEDG3, LOW);
  digitalWrite(LEDG4, LOW);
  digitalWrite(LEDG5, LOW);
  digitalWrite(LEDR1, LOW);
  digitalWrite(LEDY1, LOW);
  digitalWrite(Buzzer, LOW);
}
